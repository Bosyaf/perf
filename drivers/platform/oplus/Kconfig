## drivers/platform/oplus/Kconfig
```kconfig
menu "OPLUS System Kernel for Qualcomm platforms"
	depends on ARCH_QCOM

config OPLUS_SYSTEM_KERNEL_QCOM
	bool "Enable OPLUS System Kernel features for Qualcomm"
	default y

if OPLUS_SYSTEM_KERNEL_QCOM

config OPLUS_FEATURE_SCHED_EXT
	tristate "Sched-Ext Framework"
	default y

endif
endmenu
```

## drivers/platform/xiaomi/Kconfig
```kconfig
# Xiaomi configuration options

config MACH_XIAOMI_SM8650
	bool "Xiaomi SM8650"
	depends on ARCH_QCOM
	default y
	help
	  Support for SM8650 Xiaomi variants

menu "Xiaomi board selection"

	config MACH_XIAOMI_HOUJI
		bool "Xiaomi 14 board"
		depends on MACH_XIAOMI_SM8650
		default y
		help
		  Support for Xiaomi 14 (houji) variant

endmenu
```
